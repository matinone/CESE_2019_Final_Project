## main/Kconfig.projbuild
```kconfig
menu "WiFi configuration"

	config WIFI_SSID
		string "WIFI Network SSID"
		help
			Enter the SSID of the wifi network

	config WIFI_PASSWORD
		string "WIFI Network Password"
		help
			Enter the password of the wifi network

	choice APP_PROTOCOL
		prompt "Application Protocol"
		default HTTP
		help
			Select the Application Protocol.
	config HTTP
		bool "HTTP"
	config HTTPS
		bool "HTTPS"
	config MQTT
		bool "MQTT"
	endchoice

	config HTTP_WEBSITE
		string "HTTP target"
		default "api.thingspeak.com"
		help
			Enter the address of the target website (for HTTP only)

	config HTTPS_WEBSITE
		string "HTTPS target"
		default "www.thingspeak.com"
		help
			Enter the address of the target website (for HTTPS only)

	choice MQTT_BROKER
		prompt "MQTT_BROKER"
		default THINGSPEAK
		help
			Select the MQTT broker.
	config THINGSPEAK
		bool "ThingSpeak"
	config ADAFRUIT
		bool "Adafruit"
	endchoice
	
endmenu
```
